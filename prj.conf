## CMakeLists.txt
```
# SPDX-License-Identifier: Apache-2.0

cmake_minimum_required(VERSION 3.20.0)
find_package(Zephyr REQUIRED HINTS $ENV{ZEPHYR_BASE})
project(cyrpto_test_st_hal)
zephyr_compile_definitions(
    MBEDTLS_CONFIG_FILE=<mbedtls_config.h>
    MBEDTLS_USER_CONFIG_FILE=<mbedtls_alt_config.h>
    USE_HAL_DRIVER
)

add_subdirectory_ifdef(CONFIG_MAKE_CRYPTO_WORK_STM32 crypto_wrapper)


target_sources(app PRIVATE src/main.c)
```

## Kconfig
```
mainmenu "MYAPP"
source "Kconfig.zephyr"

config TOTAL_KEYS_REQUIRED
	int "Total numbers of keys"
	default 4

if HAS_STM32CUBE
config USE_STM32_HAL_CCB
	bool
	help
	  Enable STM32Cube CCB Module


endif # HAS_STM32CUBE

menuconfig MAKE_CRYPTO_WORK_STM32
	bool "STM32 Cryptographic Accelerator driver"
	default y
  select HAS_STM32CUBE
  select HAS_STM32LIB
  select USE_STM32_HAL_CORTEX
	select USE_STM32_HAL_CRYP
	select USE_STM32_HAL_CRYP_EX
	select USE_STM32_HAL_CCB
  select USE_STM32_HAL_RNG
  select USE_STM32_HAL_RNG_EX
	select RESET
	help
	  Enable STM32 HAL-based Cryptographic Accelerator driver.
```

## prj.conf
```kconfig
CONFIG_GPIO=y
CONFIG_CRYPTO=y
CONFIG_CRYPTO_STM32=y
CONFIG_DEBUG_THREAD_INFO=y
CONFIG_LOG=y
CONFIG_LOG_DEFAULT_LEVEL=3
CONFIG_MAIN_STACK_SIZE=10240

# secure_storage
CONFIG_FLASH=y
CONFIG_FLASH_MAP=y
CONFIG_ZMS=y
CONFIG_ZMS_ID_64BIT=y
CONFIG_TOTAL_KEYS_REQUIRED=4
CONFIG_SHELL=y
CONFIG_SHELL_BACKEND_SERIAL=y
```

## boards/nucleo_u385rg_q.overlay
```dts
/*
 * Copyright (c) 2025 STMicroelectronics
 *
 * SPDX-License-Identifier: Apache-2.0
 *
 * Overlay file for nucleo_u385rg_q board with custom flash partition layout:
 * - settings partition: 50KB
 * - file system partition: 50KB
 * - storage partition: 100KB
 */

&flash0 {
	partitions {

		/*
		 * File system partition: 48KB after settings
		 * storage ends at 0x00080000 
		 */
		file_system_partition: partition@80000 {
			label = "file_system_partition";
			reg = <0x00080000 DT_SIZE_K(48)>;
		};

		/*
		 * Audit partition: 100KB after file system
		 * file_system ends at 0x0008C000 (548KB)
		 */
		audit_partition: partition@8C000 {
			label = "audit_partition";
			reg = <0x0008C000 DT_SIZE_K(100)>;
		};
	};
};
```

## src/main.c
```c
/*
 * Copyright (c) 2016 Open-RnD Sp. z o.o.
 * Copyright (c) 2020 Nordic Semiconductor ASA
 *
 * SPDX-License-Identifier: Apache-2.0
 *
 * NOTE: If you are looking into an implementation of button events with
 * debouncing, check out `input` subsystem and `samples/subsys/input/input_dump`
 * example instead.
 */

#include <zephyr/kernel.h>
#include <zephyr/device.h>
#include <zephyr/drivers/gpio.h>
#include <zephyr/sys/util.h>
#include <zephyr/sys/printk.h>
#include <inttypes.h>
#include <stm32_crypto_wrapper.h>

#define SLEEP_TIME_MS	1

/*
 * Get button configuration from the devicetree sw0 alias. This is mandatory.
 */
#define SW0_NODE	DT_ALIAS(sw0)
#if !DT_NODE_HAS_STATUS_OKAY(SW0_NODE)
#error "Unsupported board: sw0 devicetree alias is not defined"
#endif
static const struct gpio_dt_spec button = GPIO_DT_SPEC_GET_OR(SW0_NODE, gpios,
							      {0});
static struct gpio_callback button_cb_data;

/*
 * The led0 devicetree alias is optional. If present, we'll use it
 * to turn on the LED whenever the button is pressed.
 */
static struct gpio_dt_spec led = GPIO_DT_SPEC_GET_OR(DT_ALIAS(led0), gpios,
						     {0});

void button_pressed(const struct device *dev, struct gpio_callback *cb,
		    uint32_t pins)
{
	printk("Button pressed at %" PRIu32 "\n", k_cycle_get_32());
}

int main(void)
{
	int ret;

	if (!gpio_is_ready_dt(&button)) {
		printk("Error: button device %s is not ready\n",
		       button.port->name);
		return 0;
	}

	ret = gpio_pin_configure_dt(&button, GPIO_INPUT);
	if (ret != 0) {
		printk("Error %d: failed to configure %s pin %d\n",
		       ret, button.port->name, button.pin);
		return 0;
	}

	ret = gpio_pin_interrupt_configure_dt(&button,
					      GPIO_INT_EDGE_TO_ACTIVE);
	if (ret != 0) {
		printk("Error %d: failed to configure interrupt on %s pin %d\n",
			ret, button.port->name, button.pin);
		return 0;
	}

	gpio_init_callback(&button_cb_data, button_pressed, BIT(button.pin));
	gpio_add_callback(button.port, &button_cb_data);
	printk("Set up button at %s pin %d\n", button.port->name, button.pin);

	if (led.port && !gpio_is_ready_dt(&led)) {
		printk("Error %d: LED device %s is not ready; ignoring it\n",
		       ret, led.port->name);
		led.port = NULL;
	}
	if (led.port) {
		ret = gpio_pin_configure_dt(&led, GPIO_OUTPUT);
		if (ret != 0) {
			printk("Error %d: failed to configure LED device %s pin %d\n",
			       ret, led.port->name, led.pin);
			led.port = NULL;
		} else {
			printk("Set up LED at %s pin %d\n", led.port->name, led.pin);
		}
	}

	printk("Press the button\n");
	crypto_main();
	if (led.port) {
		while (1) {
			/* If we have an LED, match its state to the button's. */
			int val = gpio_pin_get_dt(&button);

			if (val >= 0) {
				gpio_pin_set_dt(&led, val);
			}
			k_msleep(SLEEP_TIME_MS);
		}
	}
	return 0;
}
```

## src/stm32_crypto_wrapper.c
```c
#include <stm32u3xx_hal.h>
#include <soc.h>
#include "stm32_crypto_wrapper.h"
#include "stm32u3xx_hal_ccb.h"

static CCB_HandleTypeDef hccb;

/* Crypto wrapper initialization function */
void amina_crypto_init(void)
{
  /* Initialize the HAL Crypto CCB */
  hccb.Instance = CCB;
  HAL_CCB_Init(&hccb);
}
```

## src/stm32_crypto_wrapper.h
```c
#ifndef _STM32_CRYPTO_WRAPPER_H_
#define _STM32_CRYPTO_WRAPPER_H

#include <stdint.h>

void amina_crypto_init(void);

#endif /* _STM32_CRYPTO_WRAPPER_H_ */
```
